## arch/arm/configs/picoxcell_defconfig
```kconfig
CONFIG_ARCH_MULTIPLATFORM=y
CONFIG_ARCH_MULTI_V6=y
# CONFIG_ARCH_MULTI_V7 is not set
CONFIG_ARCH_PICOXCELL=y
# CONFIG_CACHE_L2X0 is not set
CONFIG_ARM_ERRATA_411920=y

CONFIG_CPU_FREQ=y
CONFIG_CPU_FREQ_STAT=y
CONFIG_CPU_FREQ_STAT_DETAILS=y
CONFIG_CPU_FREQ_GOV_PERFORMANCE=y
CONFIG_CPU_FREQ_GOV_POWERSAVE=y
CONFIG_CPU_FREQ_GOV_USERSPACE=y
CONFIG_CPU_FREQ_GOV_ONDEMAND=y
CONFIG_CPU_FREQ_GOV_CONSERVATIVE=y
CONFIG_CPU_FREQ_DEFAULT_GOV_CONSERVATIVE=y
CONFIG_CPUFREQ_DT=y

CONFIG_HZ=1000
CONFIG_HZ_1000=y
# CONFIG_HZ_PERIODIC is not set
CONFIG_NO_HZ_IDLE=y
CONFIG_NO_HZ_COMMON=y

CONFIG_HIGH_RES_TIMERS=y
CONFIG_TICK_ONESHOT=y
CONFIG_SCHED_HRTICK=y
CONFIG_GENERIC_TIME=y
CONFIG_GENERIC_CLOCKEVENTS=y

CONFIG_DEBUG_KERNEL=y
CONFIG_DEBUG_UART_8250=y
CONFIG_DEBUG_UART_PHYS=0x80230000
CONFIG_DEBUG_UART_VIRT=0xfe230000
CONFIG_DEBUG_UART_8250_SHIFT=2
CONFIG_DEBUG_UART_8250_WORD=y
# CONFIG_DEBUG_UART_8250_FLOW_CONTROL is not set
CONFIG_DEBUG_LL=y
CONFIG_DEBUG_LL_UART_8250=y
CONFIG_EARLY_PRINTK=y
CONFIG_DEBUG_FS=y

CONFIG_SERIAL_OF_PLATFORM=y
CONFIG_SERIAL_8250=y
CONFIG_SERIAL_8250_DW=y
CONFIG_SERIAL_8250_CONSOLE=y
CONFIG_SERIAL_8250_NR_UARTS=2
CONFIG_SERIAL_8250_RUNTIME_UARTS=2
# CONFIG_SERIAL_8250_DEPRECATED_OPTIONS is not set

CONFIG_SOC_PICOXCELL_PC3X3=y

CONFIG_EDAC=y
CONFIG_EDAC_MM_EDAC=y
CONFIG_EDAC_PICOXCELL=y

CONFIG_SPI=y
CONFIG_SPI_MASTER=y
CONFIG_SPI_SPIDEV=y
CONFIG_SPI_DESIGNWARE=y
CONFIG_SPI_DW_MMIO=y
CONFIG_SPI_GPIO=y

CONFIG_MMC=y
CONFIG_MMC_SPI=y

CONFIG_I2C=y
CONFIG_I2C_GPIO=y

CONFIG_HW_RANDOM=y
CONFIG_HW_RANDOM_PC3X3=y

CONFIG_WATCHDOG=y
CONFIG_DW_WATCHDOG=y

CONFIG_CRYPTO_DEV_PICOXCELL=y

CONFIG_NVMEM=y
CONFIG_PICOXCELL_AXIFUSE=y

CONFIG_GPIO_SYSFS=y

CONFIG_MFD_SYSCON=y
CONFIG_TI_DAC7512=y

CONFIG_MTD=y
CONFIG_MTD_CMDLINE_PARTS=y
CONFIG_MTD_OF_PARTS=y
CONFIG_MTD_NAND_ECC=y
CONFIG_MTD_NAND=y
CONFIG_MTD_NAND_GPIO=y
CONFIG_MTD_NAND_IDS=y
CONFIG_MTD_SPI_NOR=y
CONFIG_MTD_M25P80=y
# CONFIG_MTD_SPI_NOR_USE_4K_SECTORS is not set

CONFIG_NET=y
CONFIG_NETDEVICES=y
# CONFIG_WLAN is not set
CONFIG_ETHERNET=y
CONFIG_NET_CADENCE=y
CONFIG_MACB=y
CONFIG_GENERIC_PHY=y
CONFIG_INET=y
CONFIG_NFS_FS=y
CONFIG_IP_PNP=y
CONFIG_IP_PNP_DHCP=y
CONFIG_ROOT_NFS=y

CONFIG_PC3X3_CONFIG_PORT=y
CONFIG_PICOXCELL_SDGPIO=y

CONFIG_DEVTMPFS=y
CONFIG_DEVTMPFS_MOUNT=y
CONFIG_AEABI=y
CONFIG_UNIX=y
# CONFIG_SWAP is not set
# CONFIG_USELIB is not set
# CONFIG_LBDAF is not set
# CONFIG_BLK_DEV_BSG is not set
# CONFIG_IOSCHED_DEADLINE is not set
# CONFIG_IOSCHED_CFQ is not set
# CONFIG_ATAGS is not set

CONFIG_BLK_DEV_LOOP=y
# CONFIG_BLK_DEV_CRYPTOLOOP is not set
CONFIG_BLK_DEV_LOOP_MIN_COUNT=0

# CONFIG_INPUT_MOUSEDEV is not set
# CONFIG_INPUT_KEYBOARD is not set
# CONFIG_INPUT_MOUSE is not set
# CONFIG_SERIO is not set
# CONFIG_HID is not set
# CONFIG_USB_SUPPORT is not set
# CONFIG_IOMMU_SUPPORT is not set

CONFIG_DEBUG_PINCTRL=y
CONFIG_DEBUG_GPIO=y
```

## arch/arm/mach-picoxcell/Kconfig
```kconfig
config ARCH_PICOXCELL
	bool "Intel/Picochip picoXcell"
	depends on ARCH_MULTI_V6 && MMU
	select HAVE_TCM
	select OF
	select USE_OF
	select MFD_SYSCON
	select PINCTRL
	select PINCTRL_PC3X3
	select SPARSE_IRQ
	select ARM_VIC
	select MULTI_IRQ_HANDLER
	select DW_APB_TIMER_OF
	select HIGH_RES_TIMERS
	select COMMON_CLK
	select CLKSRC_OF
	select GENERIC_CLOCKEVENTS
	select ARCH_REQUIRE_GPIOLIB
	select GPIO_DWAPB
	select DMADEVICES
	select DW_DMAC
	help
	  Support for the Intel (formerly Picochip) picoXcell SoC family.

if ARCH_PICOXCELL

config SOC_PICOXCELL
	bool
	select SOC_BUS
	select REGMAP

config SOC_PICOXCELL_PC3X3
	bool "Picochip pc3x3 SoC support"
	depends on ARCH_PICOXCELL
	select SOC_PICOXCELL

endif
```
